; *************************************************************
; *** Scatter-Loading Description File generated by uVision ***
; *************************************************************



LR_AN_CODE_0 0x801000  0x00000600  
{; load region size_region
	ER_ROM1 0x801000   {  ; load address = execution address
        *.o (RESET, +First)
		*(InRoot$$Sections)
		startup_mhscpu.o(+RO)
	}
	
;    ER_AN_VECTOR_TABLE +0            ; load address = execution address
;    {  
;    }
;    ER_AN_STARTUP_CODE +0;0x10008000            ; load address = execution address
;    {  
;        *.o (RESET, +FIRST)
;        *.o (ifx_startup_code)
;        *.o (ifx_startup_rodata)
;    }
}



;LR_NVM_DATA_10 0x10005C00  0x00000400 
;{   ; load region size_region
;    ; the padding of this region by postlocator must be disabled with the
;    ; following parameter to postlocator: --disable-padding ER_AN_USER_RW_NVM_DATA
;    ER_AN_USER_RW_NVM_DATA  +0x00
;    {  ; load address = data address
;        *.o (*ifx_nvm_rwdata)
;    }
;}

;LR_LIB_CODE 	0x00030000 (0x00038000 - 0x00030000)  ; last : 0x00104000 (0x00150c00 - 0x00104000)
LR_LIB_CODE 	0x801200    ; last : 0x00104000 (0x00150c00 - 0x00104000)
{
;	LR_METHOD___DCZERORL		+ 0
;	{
;		__dczerorl.o
;	}
	;LR_METHOD___MAIN		+ 0
	;{
		;__main.o
	;}
	;LR_METHOD___RTENTRY2		+ 0
	;{
		;__rtentry2.o
	;}
	;LR_METHOD___RTENTRY4		+ 0
	;{
		;__rtentry4.o
	;}
	;LR_METHOD___SCATTER		+ 0
	;{
		;__scatter.o
	;}
	;LR_METHOD___SCATTER_ZI		+ 0
	;{
		;__scatter_zi.o
	;}
	LR_METHOD_AEABI_MEMSET		+ 0
	{
		aeabi_memset.o
	}
	LR_METHOD_AEABI_SDIV		+ 0
	{
		aeabi_sdiv.o
	}
	LR_METHOD_EXIT		+ 0
	{
		exit.o
	}
	LR_METHOD_HEAPAUXI		+ 0
	{
		heapauxi.o
	}
	;LR_METHOD_LIBINIT		+ 0
	;{
		;libinit.o
	;}
	;LR_METHOD_LIBINIT2		+ 0
	;{
		;libinit2.o
	;}
	;LR_METHOD_LIBSHUTDOWN		+ 0
	;{
		;libshutdown.o
	;}
	;LR_METHOD_LIBSHUTDOWN2		+ 0
	;{
		;libshutdown2.o
	;}
	LR_METHOD_LIBSPACE		+ 0
	{
		libspace.o
	}
	LR_METHOD_MEMCMP		+ 0
	{
		memcmp.o
	}
	LR_METHOD_RT_MEMCLR		+ 0
	{
		rt_memclr.o
	}
	LR_METHOD_RT_MEMCPY		+ 0
	{
		rt_memcpy.o
	}
	LR_METHOD_RT_MEMMOVE		+ 0
	{
		rt_memmove.o
	}
	;LR_METHOD_RTEXIT		+ 0
	;{
		;rtexit.o
	;}
	;LR_METHOD_RTEXIT2		+ 0
	;{
		;rtexit2.o
	;}
	LR_METHOD_SYS_EXIT		+ 0
	{
		sys_exit.o
	}
	LR_METHOD_SYS_STACKHEAP_OUTER		+ 0
	{
		sys_stackheap_outer.o
	}
	LR_METHOD_USE_NO_SEMI		+ 0
	{
		use_no_semi.o
	}
	LR_METHOD_SETJMP		+ 0
	{
		setjmp.o
	}
;	LR_METHOD_CLK_CONFIG		+ 0
;	{
;		clk_config.o
;	}
;	LR_METHOD_SM1		+ 0
;	{
;		sm1.o
;	}
;	LR_METHOD_SM4		+ 0
;	{
;		sm4.o
;	}
;	LR_METHOD_SM1_REVISE	+ 0
;	{
;		sm1_revise.o
;	}
	LR_METHOD_SULIB		+ 0
	{
		sulib.o
	}
;	LR_METHOD_CRYPTO1_API		+ 0
;	{
;		crypto1_api.o
;	}
;	LR_METHOD_CRYPTO1_FL		+ 0
;	{
;		crypto1_fl.o
;	}
;	LR_METHOD_THD89NVMLIB		+ 0
;	{
;		thd89nvmlib.o
;	}
;	LR_METHOD_ELLIPSECURVE_HAL		+ 0
;	{
;		ellipsecurve_hal.o
;	}
	
;	LR_METHOD_STARTUP_MPS_CM0		+ 0
;	{
;		startup_mps_cm0.o
;	}
;}

;;LR_PLANTFORM_CODE 	0x00038000 (0x00058000 - 0x00038000)  ; last : 0x00104000 (0x00150c00 - 0x00104000)
;LR_PLANTFORM_CODE 	0x00000D00 ;(0x0001c000 - 0x00001000)  ; last : 0x00104000 (0x00150c00 - 0x00104000)
;{
	LR_METHOD_GLOBAL_VARIABLE		+ 0
	{
		global_variable.o
	}
	
	LR_METHOD_HALDATACINFIG		+ 0
	{
		haldataconfig.o
	}
	LR_METHOD_SECOPERATIONHAL		+ 0
	{
		secoperationhal.o
	}
	LR_METHOD_7816CHANNEL		+ 0
	{
		7816channel.o
	}
	LR_METHOD_7816UTIL		+ 0
	{
		7816util.o
	}
	LR_METHOD_APDU		+ 0
	{
		apdu.o
	}
	LR_METHOD_BC_ARITH		+ 0
	{
		bc_arith.o
	}
	LR_METHOD_BC_ARRAY		+ 0
	{
		bc_array.o
	}
	LR_METHOD_BC_CONST		+ 0
	{
		bc_const.o
	}
	LR_METHOD_BC_CONTROL		+ 0
	{
		bc_control.o
	}
	LR_METHOD_BC_FIELD		+ 0
	{
		bc_field.o
	}
	LR_METHOD_BC_LOAD		+ 0
	{
		bc_load.o
	}
	LR_METHOD_BC_OBJECT		+ 0
	{
		bc_object.o
	}
	LR_METHOD_BC_RETURN		+ 0
	{
		bc_return.o
	}
	LR_METHOD_BC_STACK		+ 0
	{
		bc_stack.o
	}
	LR_METHOD_BC_STATIC		+ 0
	{
		bc_static.o
	}
	LR_METHOD_BC_STORE		+ 0
	{
		bc_store.o
	}
	LR_METHOD_BOOT		+ 0
	{
		boot.o
	}
	LR_METHOD_BOOTCONFIGMETHOD		+ 0
	{
		bootconfigmethod.o
	}
	LR_METHOD_BOOTERRORHANDLE		+ 0
	{
		booterrorhandle.o
	}
	LR_METHOD_BOOTLIFECYCLE		+ 0
	{
		bootlifecycle.o
	}
	LR_METHOD_CARDMANAGER		+ 0
	{
		cardmanager.o
	}
	LR_METHOD_CHN_MANAGER		+ 0
	{
		chn_manager.o
	}
	LR_METHOD_CONTENTMANAGER		+ 0
	{
		contentmanager.o
	}
	LR_METHOD_CONTEXT		+ 0
	{
		context.o
	}
	LR_METHOD_CRC_HAL		+ 0
	{
		crc_hal.o
	}
	LR_METHOD_CRYPTO_COMMON_API		+ 0
	{
		crypto_common_api.o
	}
	LR_METHOD_CRYPTO_IMPL		+ 0
	{
		crypto_impl.o
	}
	LR_METHOD_CVM		+ 0
	{
		cvm.o
	}
	LR_METHOD_DTRSPACE		+ 0
	{
		dtrspace.o
	}
	LR_METHOD_ECPDEFINE		+ 0
	{
		ecpdefine.o
	}
;	LR_METHOD_ELLIPSECURVE_API		+ 0
;	{
;		ellipsecurve_api.o
;	}
	LR_METHOD_ERROR		+ 0
	{
		error.o
	}
	LR_METHOD_EXCEPT		+ 0
	{
		except.o
	}
	LR_METHOD_FIREWALL		+ 0
	{
		firewall.o
	}
	LR_METHOD_FLASHBACKUP		+ 0
	{
		flashbackup.o
	}
	LR_METHOD_GC_MAIN		+ 0
	{
		gc_main.o
	}
	LR_METHOD_GRT		+ 0
	{
		grt.o
	}
	LR_METHOD_HASH_API		+ 0
	{
		hash_api.o
	}
	LR_METHOD_HASH_SHA1_HAL		+ 0
	{
		hash_sha1_hal.o
	}
	LR_METHOD_HASH_SHA256_HAL		+ 0
	{
		hash_sha256_hal.o
	}
;	LR_METHOD_HASH_SM3_HAL		+ 0
;	{
;		hash_sm3_hal.o
;	}
	LR_METHOD_INTERPRETER		+ 0
	{
		interpreter.o
	}
	LR_METHOD_IO		+ 0
	{
		io.o
	}
	LR_METHOD_IO_14443TAL3		+ 0
	{
		io_14443tal3.o
	}
	LR_METHOD_IO_14443TAL4		+ 0
	{
		io_14443tal4.o
	}
	LR_METHOD_IO_7816T0		+ 0
	{
		io_7816t0.o
	}
;	LR_METHOD_IO_7816T1		+ 0
;	{
;		io_7816t1.o
;	}
	LR_METHOD_JCVMCONFIG		+ 0
	{
		jcvmconfig.o
	}
	LR_METHOD_JCVMCONFIGMETHOD		+ 0
	{
		jcvmconfigmethod.o
	}
	LR_METHOD_JCVMINIT		+ 0
	{
		jcvminit.o
	}
	LR_METHOD_KEYMANAGER		+ 0
	{
		keymanager.o
	}
	LR_METHOD_LIFECYCLE		+ 0
	{
		lifecycle.o
	}
	LR_METHOD_LOADER		+ 0
	{
		loader.o
	}
	LR_METHOD_MEMBACKUP		+ 0
	{
		membackup.o
	}
	LR_METHOD_MEMBACKUPSERVE		+ 0
	{
		membackupserve.o
	}
	LR_METHOD_MEMNVMOPERATION		+ 0
	{
		memnvmoperation.o
	}
	LR_METHOD_MEMOPERATION		+ 0
	{
		memoperation.o
	}
	LR_METHOD_MEMOPERATIONSERVE		+ 0
	{
		memoperationserve.o
	}
	LR_METHOD_MEMORY		+ 0
	{
		memory.o
	}
	LR_METHOD_METHOD		+ 0
	{
		method.o
	}
;	LR_METHOD_MIFARE		+ 0
;	{
;		mifare.o
;	}
;	LR_METHOD_MIFAREHAL		+ 0
;	{
;		mifarehal.o
;	}
	LR_METHOD_NATIVE_INTERFACE		+ 0
	{
		native_interface.o
	}
	LR_METHOD_NATIVEMETHOD_IMPL		+ 0
	{
		nativemethod_impl.o
	}
	LR_METHOD_NVMHAL		+ 0
	{
		nvmhal.o
	}
	LR_METHOD_OB_MANAGER		+ 0
	{
		ob_manager.o
	}
	LR_METHOD_OBJECT		+ 0
	{
		object.o
	}
	LR_METHOD_OPFUNCTION		+ 0
	{
		opfunction.o
	}
	LR_METHOD_OPINSTALLER		+ 0
	{
		opinstaller.o
	}
	LR_METHOD_PACKAGELOC		+ 0
	{
		packageloc.o
	}
;	LR_METHOD_PATCH		+ 0
;	{
;		patch.o
;	}
;	LR_METHOD_PATCHHAL		+ 0
;	{
;		patchhal.o
;	}
;	LR_METHOD_PATCHSEARCH		+ 0
;	{
;		patchsearch.o
;	}
;	LR_METHOD_RAMALLOCATE		+ 0
;	{
;		ramallocate.o
;	}
;	LR_METHOD_RAMDEALLOCATE		+ 0
;	{
;		ramdeallocate.o
;	}
	LR_METHOD_RAMMANAGER		+ 0
	{
		rammanager.o
	}
	LR_METHOD_REFERENCE		+ 0
	{
		reference.o
	}
	LR_METHOD_RESET		+ 0
	{
		reset.o
	}
	LR_METHOD_RFHAL		+ 0
	{
		rfhal.o
	}
	LR_METHOD_RNG_HAL		+ 0
	{
		rng_hal.o
	}
	LR_METHOD_RSA_API		+ 0
	{
		rsa_api.o
	}
	LR_METHOD_RSA_HAL		+ 0
	{
		rsa_hal.o
	}
	LR_METHOD_STACK		+ 0
	{
		stack.o
	}
	LR_METHOD_SYM_AES_HAL		+ 0
	{
		sym_aes_hal.o
	}
	LR_METHOD_SYM_API		+ 0
	{
		sym_api.o
	}
	LR_METHOD_SYM_DES_HAL		+ 0
	{
		sym_des_hal.o
	}
;	LR_METHOD_SYM_SM1_HAL		+ 0
;	{
;		sym_sm1_hal.o
;	}
;	LR_METHOD_SYM_SM4_HAL		+ 0
;	{
;		sym_sm4_hal.o
;	}
	LR_METHOD_SYSCONFIG		+ 0
	{
		sysconfig.o
	}
	LR_METHOD_SYSHAL		+ 0
	{
		syshal.o
	}
;	LR_METHOD_THD89COREFUNCTION		+ 0
;	{
;		thd89corefunction.o
;	}
;	LR_METHOD_THD89FUNCTION		+ 0
;	{
;		thd89function.o
;	}
	LR_METHOD_UARTHAL		+ 0
	{
		uarthal.o
	}
	LR_METHOD_UTILMETHOD		+ 0
	{
		utilmethod.o
	}
	LR_METHOD_WTXINTERUPT		+ 0
	{
		wtxinterupt.o
	}
	LR_METHOD_WTXTIMER		+ 0
	{
		wtxtimer.o
	}
	LR_METHOD_WTXTIMERHAL		+ 0
	{
		wtxtimerhal.o
	}
		ER_NVM_NAT_PBOC_CODE1                 +0
    {
        NativeAppComponent.o           ( natAppComEntry_data )
    }
    ER_NVM_NAT_PBOC_CODE                 +0
    {
        NativeAppComponent.o           ( text,                             +RO )
    }
;}

;LR_ROM2 0x0001d000 ;(0x00060000 - 0x0001c000)
;{
;  ER_ROM2 0x0001d000   {  ; load address = execution address

	ER_ROM2  +0 
	{   
;		*(InRoot$$Sections)
	   .ANY (+RO)
;	   hci_pipe.o(+CODE)
	}
;	RW_RAM1 0x20001400 0x3400
;	{  ; RW data
;	 .ANY (+RW +ZI)
;	}  
}

; RAM user data like stacks etc.
LR_RAM_AN_0 +0
{
    ; at RAM address 0x20000000 the IFX VolatileUserMailboxArea is located after BOS startup
    ; this area may be also used by the OS to keep interface information up to date

    ER_AN_USER_STACK 0x20000000 UNINIT     ; RW data
    {
       *.o (STACK)
    }
	
;    ER_AN_PRIV_STACK +0x0 UNINIT    ; RW data
;    {
;        *.o (ifx_priv_stack)
;    }
;    ; RAM memory mapping 
;    ER_AN_SEC_RW_DATA 0x20001040  UNINIT 0x40
;    {
;        *.o(ifx_sec_rwdata)
;    }

    ER_AN_RW_DATA +0  UNINIT                         ; RW data
    {
    ; at RAM address 0x20000000 the IFX VolatileUserMailboxArea is located after BOS startup
    ; this area may be also used by the OS to keep interface information up to date

        .ANY (+RW +ZI)
    }

}

LR_APDUBUFFER_RAM  0x20003000  0x1600
{   
    ER_DtTrRamAlign_RAM +0 UNINIT                                                                           
	{                                                 
		CreateJavaBuffer.o (.bss.DtTrRamAlign)                                                                                     
	}
;	ER_PBOC_instRAMBuff_RAM +0 UNINIT                                                                                   
;	{                                                                                                                  
;		CreateJavaBuffer.o(.bss.g_PBOC_instRAMBuff)                                                                               
;	}
	ER_AN_APDUBUFFER_RAM +0 UNINIT                                                                          
	{                                                 
		CreateJavaBuffer.o (+RW +ZI)                                                                                     
	}
	ER_cacheBuffer_RAM +0  UNINIT                                                                                    
	{                                                                                                                  
		CreateJavaBuffer.o(.bss.cacheBuffer)                                                                             
	}
	ER_bRamBuffer_RAM +0  UNINIT                                                                                    
	{                                                                                                                  
		CreateJavaBuffer.o(.bss.bRamBuffer)                                                                             
	}
	ER_bShortBuffer_RAM +0  UNINIT                                                                                    
	{                                                                                                                  
		CreateJavaBuffer.o(.bss.bShortBuffer)                                                                             
	} 
}



LR_JVM 0x85AC00   NOCOMPRESS
{
	rommask +0     ; fixed                                                                                               
	{                                                                                                                  
	    mask.o(.constdata)
	} 
;	mapTableAlign +0     ; fixed                                                                                               
;	{                                                                                                                  
;	    mask.o(.constdata)
;	}
;	staticinit +0     ; fixed                                                                                               
;	{                                                                                                                  
;	    mask.o(.constdata)
;	}	
}

LR_CONFIG_DATA_FILE  0x86E800  0x600
{
	HAL_CONFIG_DATA_FILE +0  FIXED
	{
		halDataConfig.o(sysConfigDataArea) 
	}	
	CHIP_CONFIG_DATA_FILE +0  FIXED
	{
		chipDataConfig.o(chipConfigDataArea)
	}	
	JCVM_CONFIG_DATA_FILE +0  FIXED
	{
		JcvmDataConfig.o(vmConfigDataArea)
	}	
}


LR_SCP_DATAAREA 0x87E400  0x600  
{
	ER_SCP_DATAAREA +0
	{
		*.o(ScpDataArea)
	}
}


LR_LOGICCHN_BAK_AREA 0x87EA00  0x800
{
	ER_LOGICCHN_BAK_AREA +0 
	{
		*.o(LogicBakDataArea)
	}
}
LR_CRCDATA 0x87F200   0x200
{
	ER_CRCAREA_START +0
	{
	 *.o(CRCDataArea)
	}
}



LR_SEINFO 0x87F400   0x200
{
	ER_SEINFO_START +0
	{
		*.o(seInfoDataArea)
	}
}

LR_PATCHJUMPCODE 0x87F600  0x200
{
	ER_PATCHJUMPCODE_START +0
	{
		*.o(PatchJumpCode_Segment)
	}
}



LR_PATCH 0x87F800  0x800 
{
	ER_PATCH_START   +0
	{
		;PrivateCommand.o(getSessionkey_patch1)
		
	}
}



