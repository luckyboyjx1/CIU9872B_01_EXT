/*
 * MifareLib.c
 *
 *  Created on: 2015年4月3日
 *      Author: jiangxiaohui
 */


#include "ecpDefine.h"
#include "DataOperation.h"
#include "MifareLib.h"
#include "RfHal.h"
#include "NvmHal.h"
#include "Crypto_common_API.h"

u8	MifareLibState;

#if 1
u8 CONST MIFARE_S50_SYS_FILE[0x400] = {
//	0x01, 0x02, 0x03, 0x04, 0x04, 0x28, 0x04, 0x00, 0xE7, 0x00, 0x00, 0x00, 0x00,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 0xFF,
//	0x00, 0x00, 0x00, 0x00, 0x00, 0x00, 0x00, 0x00, 0x00, 0x00, 0x00, 0x00, 0x00,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 0xFF,
	0x11, 0x11, 0x11, 0x11, 0x11, 0x11, 0x11, 0x11, 0x11, 0x11, 0x11, 0x11,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 0xFF,
	0x00, 0x00, 0x00, 0x00, 0x00, 0x00, 0x00, 0x00, 0x00, 0x00, 0x00, 0x00,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 0xFF,
	0x00, 0x00, 0x00, 0x00, 0x00, 0x00, 0x00, 0x00, 0x00, 0x00, 0x00, 0x00,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 0xFF,
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	0x00, 0x00, 0x00, 0x00, 0x00, 0x00, 0x00, 0x00, 0x00, 0x00, 0x00, 0x00,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 0xFF
};
#endif

#if 0
static u8 CONST MIFARE_S70_SYS_FILE[0x400] = {
	0x11, 0x11, 0x11, 0x11, 0x11, 0x11, 0x11, 0x11, 0x11, 0x11, 0x11, 0x11,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 0xFF,
	0x00, 0x00, 0x00, 0x00, 0x00, 0x00, 0x00, 0x00, 0x00, 0x00, 0x00, 0x00,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 0xFF,
	0x00, 0x00, 0x00, 0x00, 0x00, 0x00, 0x00, 0x00, 0x00, 0x00, 0x00, 0x00,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 0xFF,
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	0x00, 0x00, 0x00, 0x00, 0x00, 0x00, 0x00, 0x00, 0x00, 0x00, 0x00, 0x00,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 0xFF
};
#endif

void MifareLib_changeState()
{
	MifareLibState = 1;
}

u8 MifareLib_getState()
{
	return MifareLibState;
}

u8 mifareLib_CmdParaInit(mifareLib_cmd_para_t *	myMifareLib_cmdPara, u8 currentBlockNumber)
{
	PM8						tempCurrentBlockAdd;
	u8						tempCurrentSector;
	u8						tempRelatiBlock;
	u8						tempCurrentBlock;
	u8						paraInitResult;
	u8						accCondIndex;
	tempCurrentBlock		= currentBlockNumber;
	paraInitResult			= 0x00;

	//block[0,127]:sector[0,31],block[128,255]:sector[32,39]
	if(tempCurrentBlock & 0x80)
	{
		tempRelatiBlock			= tempCurrentBlock & 0x0F;
		tempCurrentSector		= (tempCurrentBlock >> 4) & 0x07;
		tempCurrentBlockAdd		= MEMtPM8(U8_M_U16(tempCurrentSector, 0x100) + 0x800);
		tempCurrentSector		+= 0x20;
		accCondIndex			= MIFARE_AUTH_KEY_M4_OFFSET;
	}
	else
	{
		tempRelatiBlock			= tempCurrentBlock & 0x03;
		tempCurrentSector		= tempCurrentBlock >> 2;
		tempCurrentBlockAdd		= MEMtPM8(U8_M_U16(tempCurrentSector, 0x40));
		accCondIndex			= MIFARE_AUTH_KEY_M1_OFFSET;
	}

	tempCurrentBlockAdd			= PM8_A_U32(MifareLib_getMifareAddress(), tempCurrentBlockAdd);

	myMifareLib_cmdPara->currentBlockAdd 	= PM8_A_U16(tempCurrentBlockAdd, U8_M_U8(tempRelatiBlock, MIFARE_BLOCK_SIZE));
	myMifareLib_cmdPara->currentSector 		= tempCurrentSector;
	myMifareLib_cmdPara->relatiBlock 		= tempRelatiBlock;
	myMifareLib_cmdPara->accCondBlockAdd	= PM8_A_U32(tempCurrentBlockAdd, accCondIndex);

	return paraInitResult;
}

void MifareLib_authProcess(mifare_para_t * myMifarePara, PM8 mifareKeyPoint)
{
//	rf_setkey(myMifarePara->key);
//	if(MIFARE_MIFARE == myMifarePara->crypt)
//	{
//		rf_setauthen(1);
//		rf_initm1(mifareKeyPoint);
//	}
//	else
//	{
//		rf_setauthen(2);
//		rf_inithh(mifareKeyPoint);
//	}
//	sys_changeclk(HCLK_OSC16);
//	rf_sleep(RF_AUTHRX);
//	sys_changeclk(chipConfig_GetHclock());
//	if (rf_getauthen()==FAILED || rf_geterr())
//	{
//		MifareLib_changeState();
//	}
//	else
//	{
//		if(MIFARE_MIFARE == myMifarePara->crypt)
//		{
//			rf_setcrypt(2);
//		}
//		else
//		{
//			rf_setcrypt(1);
//		}
//	}
}


u8 MifareLib_NvmProgram(PN8 DestBlockAdd, PX8 inData, u16 dataLen)
{
	ecpNvm_WriteErase(DestBlockAdd, inData, dataLen);
	ecpNvm_WriteCommit();
	if(ecpNvm_CheckWrite(DestBlockAdd, inData, dataLen))
	{
		return MIFARE_NVM_PROGRAM_SUCCESS;
	}
	else
	{
		return MIFARE_NVM_PROGRAM_FAILED;
	}
}

void MifareLib_SendNAK(u8 NAKCode)
{
	u8						mifareDataOut[1];
	mifareDataOut[0]		= NAKCode;
//	MifareLib_send(mifareDataOut,1,1);
	MifareLib_changeState();
}

void MifareLib_SendACK(void)
{
	u8						mifareDataOut[1];
	mifareDataOut[0]		= MIFARE_CLASSIC_ACK;
//	MifareLib_send(mifareDataOut, 1, 1);
}

u8 MifareLib_sendPart1_receivePart2(PX8 mifareDataOut, PX8 mifareCommond, u16 expLen, u8 flags)
{
//	u16						X_A		length;
//	u16						D_A		ciuResult;
//	MifareLib_send(mifareDataOut, 1, 1);
//	//2nd frame
//	ciuResult 				= MifareLib_recv(mifareCommond, U8_A_U8(MIFARE_BLOCK_SIZE, MIFARE_BLOCK_CRC_SIZE), &length, flags, U8_M_U8(MIFARE_BLOCK_SIZE, 0x02));
//
//	if (PHDD_CIU_RX_CHECKVALUE_ERROR == ciuResult)//crc & parity error
//	{
//		mifareDataOut[0]=0x05;
//		MifareLib_send(mifareDataOut, 1, 1);
//	}
//	if ((PHDD_CIU_OK != ciuResult) || (expLen != length))//rf error || command length error
//	{
//		MifareLib_SendNAK(MIFARE_CLASSIC_NAK_STATUS_4);
//		length = 0xFF;
//	}
//	return length;
	return 0;
}

u8 MifareLib_sendRes_receiveCom(PX8 mifareDataOut, PX8 mifareCommond, u16 len, u8 flags)
{
//	u16						X_A		length;
//	u16						D_A		ciuResult;
//
//	if(0x00 != len)
//	{
//		MifareLib_send(mifareDataOut, len, (u8)(flags | PHDD_CIU_CRC_ON));
//	}
//	//1nd frame
//	ciuResult 				= MifareLib_recv(mifareCommond, U8_A_U8(MIFARE_BLOCK_SIZE, MIFARE_BLOCK_CRC_SIZE), &length, flags, U8_M_U8(MIFARE_BLOCK_SIZE, 0x02));
//
//	if (PHDD_CIU_RX_CHECKVALUE_ERROR == ciuResult)//crc & parity error
//	{
//		mifareDataOut[0]=0x05;
//		MifareLib_send(mifareDataOut, 1, 1);
//	}
//	if ((PHDD_CIU_OK != ciuResult) || (MIFARE_COMMOND_SIZE != length))//rf error || command length error
//	{
//		MifareLib_changeState();
//	}
//	return length;
	return 0;
}

PX8 MifareLib_getMifReusBuf(void)
{
	return 0;
}

mifare_para_t * MifareLib_getMifarePara(void)
{
	return (mifare_para_t *)MifareLib_getMifReusBuf;
}

PM8 MifareLib_getMifareAddress(void)
{
//	return chip_getMifareAddress();
	return MEMtPM8(0xc0A000);
}

void MifareLib_setMifareAddress(u32 addr)
{
	//setting mifare eeprom start address 
//	return chip_setMifareAddress();
}

void MifareLib_initParam(mifare_para_t * myMifareParm)
{
	myMifareParm->sector	= 0;
	myMifareParm->key		= 0;
	myMifareParm->crypt		= MIFARE_MIFARE;
	myMifareParm->isAuth	= 0;
	
	MifareLibState			= 0x00;
}


void MifareLib_auth(PX8 mifareCommond, mifare_para_t * myMifarePara)
{
	PM8				     mifareKeyPoint;

	mifareLib_cmd_para_t	mifareLib_cmdPara;
	mifareLib_CmdParaInit(&mifareLib_cmdPara, mifareCommond[MIFARE_COMMOD_ADDR_OFFSET]);

	myMifarePara->key	= mifareCommond[MIFARE_COMMOD_CMD_OFFSET] & 0x01;
	mifareKeyPoint		= mifareLib_cmdPara.accCondBlockAdd;
	if(MIFARE_KEY_TYPE_B == myMifarePara->key) // key B
	{
		mifareKeyPoint	= PM8_A_U8(mifareKeyPoint, MIFARE_AUTH_KEY_B_OFFSET);
	}
	MifareLib_authProcess(myMifarePara, mifareKeyPoint);
	if(0x00 == MifareLib_getState())
	{
		myMifarePara->sector = mifareLib_cmdPara.currentSector;
	}
}

//function:osmifare read
//note:30 blockaddr
//uint8:读取数据字节数
u8 MifareLib_read(PX8 mifareDataOut, PX8 mifareCommond, mifare_para_t * myMifarePara)
{
	u8						accCondChecRes;
	mifareLib_cmd_para_t	mifareLib_cmdPara;

	mifareLib_CmdParaInit(&mifareLib_cmdPara, mifareCommond[MIFARE_COMMOD_ADDR_OFFSET]);
	if (myMifarePara->sector != mifareLib_cmdPara.currentSector)
	{
		MifareLib_SendNAK(MIFARE_CLASSIC_NAK_STATUS_4);
		return 0;
	}

	accCondChecRes			= MifareLib_checkAcce(mifareLib_cmdPara.accCondBlockAdd, mifareLib_cmdPara.currentSector, mifareLib_cmdPara.relatiBlock, myMifarePara->key, MIFARE_R);

	if (!accCondChecRes)
	{
		MifareLib_SendNAK(MIFARE_CLASSIC_NAK_STATUS_4);
		return 0;
	}
	ecpMem_Copy(mifareDataOut, mifareLib_cmdPara.currentBlockAdd, MIFARE_BLOCK_SIZE);
	if (!(accCondChecRes & 0x1))
	{
		if (!(accCondChecRes & 0x2))
		{
			ecpMem_Set(&mifareDataOut[MIFARE_AUTH_KEY_A_OFFSET], 0, MIFARE_AUTH_KEY_A_LENGTH);
		}
		if (!(accCondChecRes & 0x4))
		{
			ecpMem_Set(&mifareDataOut[MIFARE_ACCESS_COND_OFFSET], 0, MIFARE_ACCESS_COND_LENGTH);
		}
		if (!(accCondChecRes & 0x8))
		{
			ecpMem_Set(&mifareDataOut[MIFARE_AUTH_KEY_B_OFFSET], 0, MIFARE_AUTH_KEY_B_LENGTH);
		}
	}

	return MIFARE_BLOCK_SIZE;
}


//function:osmifare write
//note:a0 blockaddr
void MifareLib_write(PX8 mifareDataOut, PX8 mifareCommond, mifare_para_t * myMifarePara)
{
	u8						accCondChecRes;
	u8						tempData[MIFARE_BLOCK_SIZE];
	mifareLib_cmd_para_t	mifareLib_cmdPara;

	mifareLib_CmdParaInit(&mifareLib_cmdPara, mifareCommond[MIFARE_COMMOD_ADDR_OFFSET]);
	if (myMifarePara->sector != mifareLib_cmdPara.currentSector)
	{
		MifareLib_SendNAK(MIFARE_CLASSIC_NAK_STATUS_4);
		return;
	}

	accCondChecRes			= MifareLib_checkAcce(mifareLib_cmdPara.accCondBlockAdd, mifareLib_cmdPara.currentSector, mifareLib_cmdPara.relatiBlock, myMifarePara->key, MIFARE_W);
	if (!accCondChecRes)
	{
		MifareLib_SendNAK(MIFARE_CLASSIC_NAK_STATUS_4);
		return;
	}

	mifareDataOut[0]=0x0a;
	if(0xFF == MifareLib_sendPart1_receivePart2(mifareDataOut, mifareCommond, MIFARE_BLOCK_SIZE, 1))
	{
		return;
	}

	ecpMem_Copy(tempData, mifareCommond, MIFARE_BLOCK_SIZE);
	if (!(accCondChecRes & 0x1))
	{
		if (!(accCondChecRes & 0x2))
		{
			ecpMem_Set(tempData, 0, 6);
		}
		if (!(accCondChecRes & 0x4))
		{
			ecpMem_Set(&tempData[6], 0, 4);
		}
		if (!(accCondChecRes & 0x8))
		{
			ecpMem_Set(&tempData[10], 0, 6);
		}
	}

	if (MIFARE_NVM_PROGRAM_FAILED == MifareLib_NvmProgram(mifareLib_cmdPara.currentBlockAdd, tempData, MIFARE_BLOCK_SIZE))
	{
		MifareLib_SendNAK(MIFARE_CLASSIC_NAK_STATUS_4);
		return;
	}
	MifareLib_SendACK();
}

//function:osmifare inc/dec/restore/transfer
//note:c1/c0/c2/b0 blockaddr
void MifareLib_MFIdrt(PX8 mifareDataOut, PX8 mifareCommond, mifare_para_t * myMifarePara)
{
	u8						firstMifareCmd;
	u8						accCondChecRes;
	u32						tempData[3];//仅使用了数值块的数值区
	static u8 mark_flag=0;//加/减/存储与传输的可操作标记.0-不可执行传输,1-可执行传输
	static u32 mark_value;//操作数值
	mifareLib_cmd_para_t	mifareLib_cmdPara;

	mifareLib_CmdParaInit(&mifareLib_cmdPara, mifareCommond[MIFARE_COMMOD_ADDR_OFFSET]);

	firstMifareCmd = mifareCommond[MIFARE_COMMOD_CMD_OFFSET];
	if ((myMifarePara->sector != mifareLib_cmdPara.currentSector) || ((CLA_TRANSFER == firstMifareCmd) && (0x00 == mark_flag)))
	{
		MifareLib_SendNAK(MIFARE_CLASSIC_NAK_STATUS_4);
		return;
	}

	accCondChecRes=MifareLib_checkAcce(mifareLib_cmdPara.accCondBlockAdd, mifareLib_cmdPara.currentSector, mifareLib_cmdPara.relatiBlock, myMifarePara->key, mifareCommond[0]==CLA_INC ? MIFARE_I : MIFARE_DRT);
	if (!accCondChecRes)
	{
		MifareLib_SendNAK(MIFARE_CLASSIC_NAK_STATUS_4);
		return;
	}

	if (CLA_TRANSFER == firstMifareCmd)
	{
		tempData[0] = mark_value;
		tempData[1] = ~tempData[0];
		tempData[2] = tempData[0];
		if (MIFARE_NVM_PROGRAM_FAILED == MifareLib_NvmProgram(mifareLib_cmdPara.currentBlockAdd, MEMtPX8(tempData), MIFARE_VALUEBLOCK_VALUE_SIZE))
		{
			MifareLib_SendNAK(MIFARE_CLASSIC_NAK_STATUS_4);
			return;
		}
		mark_flag=0;
		MifareLib_SendACK();
	}
	else
	{
		ecpMem_Copy(MEMtPX8(tempData), mifareLib_cmdPara.currentBlockAdd, MIFARE_VALUEBLOCK_VALUE_SIZE);
		BigEndian2LittleEndian(MEMtPX8(tempData), MIFARE_VALUEBLOCK_VALUE_SIZE);
		if (														\
				tempData[0] != tempData[2] || 						\
				tempData[0] != ~tempData[1] ||						\
				mifareLib_cmdPara.currentBlockAdd[12] != mifareLib_cmdPara.currentBlockAdd[14] ||		\
				mifareLib_cmdPara.currentBlockAdd[13] != mifareLib_cmdPara.currentBlockAdd[15] || 		\
				mifareLib_cmdPara.currentBlockAdd[12] != U8_INV(mifareLib_cmdPara.currentBlockAdd[13])	\
				)//value block error
		{
			MifareLib_SendNAK(MIFARE_CLASSIC_NAK_STATUS_4);
			return;
		}

		//2nd frame
		mifareDataOut[0] 	= 0x0a;
		if(0xFF == MifareLib_sendPart1_receivePart2(mifareDataOut, mifareCommond, MIFARE_VALUE_SIZE, 1))
		{
			return;
		}

		mifareCommond[3] &= 0x7f;//去掉符号位
		mark_value			= PX_R_U32(mifareCommond);
		BigEndian2LittleEndian(MEMtPX8(&mark_value), MIFARE_VALUEBLOCK_ADDR_SIZE);
		switch(firstMifareCmd)
		{
		case CLA_INC:
			if(!(tempData[0] & 0x80000000) && (0x7fffffff - tempData[0]) <mark_value)
			{
				MifareLib_SendNAK(MIFARE_CLASSIC_NAK_STATUS_4);
				break;
			}
			mark_value 		+= tempData[0];
			mark_flag 		= 1;
			break;
		case CLA_DEC:
			if((tempData[0] & 0x80000000) && (0x7fffffff - ~(tempData[0]-1))<mark_value)
			{
				MifareLib_SendNAK(MIFARE_CLASSIC_NAK_STATUS_4);
				break;
			}
			mark_value 		= tempData[0] - mark_value;
			mark_flag 		= 1;
			break;
		case CLA_RESTORE:
			mark_value 		= tempData[0];
			mark_flag 		= 1;
			break;
		}
	}
	return;
}

//function:osmifare halt
//note:5x blockaddr
void MifareLib_halt(PX8 result, PX8 content)
{
//	rf_setpicc(RF_PICC_HALT);
//	g_state=PICC_ACTIVE_STAR;
}

//uint8 sector:扇区序号
//uint8 block:块序号
//uint8 key:可操作的密钥类型.0-keya,1-keyb,2-keyab,3-never
//uint8 config:访问命令
//bit0~1:MIFARE_R-read,MIFARE_W-write,MIFARE_I-inc,MIFARE_DRT-dec/restore/transfer
//uint8:访问权限
//bit0:数据块/制造块.0-无,1-有.
//bit1:控制块keya区.0-无,1-有.
//bit2:控制块ctrl区.0-无,1-有.
//bit3:控制块keyb区.0-无,1-有.
u8 MifareLib_checkAcce(PM8 accCondBlockAdd, u8 currentSector, u8 relatiBlock, u8 key, u8 config)
{
	PM8					currentAccePoint;
	u8					accessCondition[4];
	u8					accCondChecRes;
	u8 					temp;
	u8 					control;

	currentAccePoint			= PM8_A_U8(accCondBlockAdd, MIFARE_ACCESS_COND_OFFSET);
	ecpMem_Copy(accessCondition, currentAccePoint, 0x04);
	if(
			(((accessCondition[0] & 0x0f) 	^ (accessCondition[1] >> 0x04))	!= 0x0f) ||
			(((accessCondition[1] & 0x0f) 	^ (accessCondition[2] >> 0x04))	!= 0x0f) ||
			(((accessCondition[2] & 0x0f)	^ (accessCondition[0] >> 0x04))	!= 0x0f)
		)
	{
		return 0x0;
	}

	//manufacture block
	if ((0x00 == currentSector) && (0x00 == relatiBlock))
	{
		if(MIFARE_R == config)
		{
			return 0x01;
		}
		else
		{
			return 0x00;
		}
	}
	//data block
	if(currentSector < 0x20)
	{
		temp					= relatiBlock;
	}
	else
	{
		temp					= relatiBlock / 5;
	}

	control						=  (accessCondition[1] & (1 << (4 + temp))) 		>> (2 + temp);
	control						+= (accessCondition[2] & (1 << (4 + temp)))			>> (4 + temp);
	control						+= ((accessCondition[2] & (1 << temp)) >> temp) 	<< 1;

	if (temp != 3)
	{
		return (MIFARE_KEY_TYPE_AB == MifareLb_data[control][config]) || (MifareLb_data[control][config] == key ? 0x1 : 0x0);
	}
	//control block
	if ((config != MIFARE_R) && (config != MIFARE_W))
	{
		return 0x0;
	}

	accCondChecRes			= 0x0;

	if (MIFARE_W == config)
	{
		control 	+= 8;
	}
	if (/*((MIFARE_KEY_NEVER != MifareLb_key[control][0]) && (MIFARE_KEY_TYPE_AB == key)) || */(MifareLb_key[control][0] == key) || (MIFARE_KEY_TYPE_AB == MifareLb_key[control][0]))//keya
	{
		accCondChecRes 		|= 0x2;
	}
	if (/*((MIFARE_KEY_NEVER != MifareLb_key[control][1]) && (MIFARE_KEY_TYPE_AB == key)) || */(MifareLb_key[control][1] == key) || (MIFARE_KEY_TYPE_AB == MifareLb_key[control][1]))//ctrl
	{
		accCondChecRes 		|= 0x4;
	}
	if (/*((MIFARE_KEY_NEVER != MifareLb_key[control][2]) && (MIFARE_KEY_TYPE_AB == key)) || */(MifareLb_key[control][2] == key) || (MIFARE_KEY_TYPE_AB == MifareLb_key[control][2]))//keyb
	{
		accCondChecRes 		|= 0x8;
	}

	return accCondChecRes;
}


